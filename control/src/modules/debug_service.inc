// USB console and optional read-only debug page.
void serialConsole(){static char b[64];static uint8_t n=0;while(Serial.available()){char c=Serial.read();if(c=='\n'||c=='\r'){if(n){b[n]=0;command(b);n=0;}}else if(n<sizeof(b)-1)b[n++]=c;}}
void webStatus(){char b[700];snprintf(b,sizeof(b),"{\"firmware\":\"%s\",\"state\":\"%s\",\"bno_ready\":%s,\"bno_addr\":\"0x%02X\",\"tof_ready\":%s,\"tof_frames\":%lu,\"ina_ready\":%s,\"ina_errors\":%lu,\"pca_ready\":%s,\"vesc_erpm\":%.1f,\"vesc_duty\":%.4f,\"vesc_requests\":%lu,\"vesc_responses\":%lu,\"vesc_errors\":%lu,\"link_queue\":%u,\"link_drops\":%lu,\"link_highwater\":%lu}",kFirmwareVersion,stateName(safety),imu.ready()?"true":"false",imu.address(),tofReady?"true":"false",tofFrames,inaReady?"true":"false",(unsigned long)ina.errors,pcaReady?"true":"false",vescValues.erpm,vescValues.duty,vescReq,vescResp,vescErrors,linkUsed,(unsigned long)linkDrops,(unsigned long)linkQueueHighWater);web.send(200,"application/json",b);} const char webPage[]=R"HTML(<!doctype html><meta name=viewport content="width=device-width,initial-scale=1"><style>body{font:16px system-ui;background:#101820;color:#e8eef5}.c{margin:10px;padding:12px;background:#1d2935;border-radius:8px;white-space:pre-wrap}</style><h2 class=c>XIAO boat integration: bench status</h2><div class=c id="s">loading</div><div class=c>Temporary read-only Wi-Fi diagnostic. No actuator controls are available here.</div><script>async function u(){try{let j=await(await fetch("/api/status",{cache:"no-store"})).json();s.textContent=`State: ${j.state}\nBNO: ${j.bno_ready} ${j.bno_addr}\nToF: ${j.tof_ready}, frames ${j.tof_frames}\nINA: ${j.ina_ready}, errors ${j.ina_errors}\nPCA: ${j.pca_ready}\nVESC: ${j.vesc_erpm.toFixed(1)} ERPM, duty ${j.vesc_duty.toFixed(4)}\nVESC request/response/error: ${j.vesc_requests}/${j.vesc_responses}/${j.vesc_errors}\nLink queue/drop/high-water: ${j.link_queue}/${j.link_drops}/${j.link_highwater}`}catch(e){s.textContent="update failed"}}setInterval(u,1000);u()</script>)HTML"; void startDebugWifi(){if(!kEnableTemporaryDebugWifi)return;WiFi.mode(WIFI_AP);WiFi.softAP(kDebugApSsid,kDebugApPass);web.on("/",HTTP_GET,[]{web.send(200,"text/html",webPage);});web.on("/api/status",HTTP_GET,webStatus);web.begin();Serial.printf("DEBUG_WIFI SSID=%s IP=%s\n",kDebugApSsid,WiFi.softAPIP().toString().c_str());}
