// CoreS3 UART transport and VESC output primitives.
uint64_t nowUs(){return esp_timer_get_time();}
uint32_t nextLinkSequence(){portENTER_CRITICAL(&linkMux);const uint32_t sequence=++linkSeq;portEXIT_CRITICAL(&linkMux);return sequence;}
uint32_t currentLinkSequence(){portENTER_CRITICAL(&linkMux);const uint32_t sequence=linkSeq;portEXIT_CRITICAL(&linkMux);return sequence;}
const char* protocolTypeName(uint8_t type){switch((boat::Type)type){case boat::Type::Hello:return "Hello";case boat::Type::BnoAccel:return "BnoAccel";case boat::Type::BnoGyro:return "BnoGyro";case boat::Type::BnoQuaternion:return "BnoQuaternion";case boat::Type::TofFrame:return "TofFrame";case boat::Type::InaSample:return "InaSample";case boat::Type::VescStatus:return "VescStatus";case boat::Type::ActuatorState:return "ActuatorState";case boat::Type::SystemHealth:return "SystemHealth";case boat::Type::Event:return "Event";case boat::Type::TimeSyncReply:return "TimeSyncReply";case boat::Type::GnssRaw:return "GnssRaw";case boat::Type::GnssFix:return "GnssFix";case boat::Type::GnssStatus:return "GnssStatus";case boat::Type::GnssNav:return "GnssNav";case boat::Type::GnssProcessResult:return "GnssProcessResult";case boat::Type::CommandAck:return "CommandAck";case boat::Type::TimeSyncRequest:return "TimeSyncRequest";case boat::Type::LinkStatistics:return "LinkStatistics";case boat::Type::BnoMagnetic:return "BnoMagnetic";case boat::Type::TimingDiagnostic:return "TimingDiagnostic";case boat::Type::EstimatedState:return "EstimatedState";case boat::Type::P1Capture:return "P1Capture";case boat::Type::PrimaryImuSnapshot:return "PrimaryImuSnapshot";case boat::Type::ProvisionalSystem:return "ProvisionalSystem";case boat::Type::CalibrationMarker:return "CalibrationMarker";case boat::Type::Heartbeat:return "Heartbeat";case boat::Type::Arm:return "Arm";case boat::Type::Disarm:return "Disarm";case boat::Type::StartTest:return "StartTest";case boat::Type::Stop:return "Stop";case boat::Type::Estop:return "Estop";case boat::Type::ClearEstop:return "ClearEstop";case boat::Type::BenchmarkPrepare:return "BenchmarkPrepare";case boat::Type::BenchmarkReady:return "BenchmarkReady";case boat::Type::BenchmarkStart:return "BenchmarkStart";case boat::Type::BenchmarkStop:return "BenchmarkStop";case boat::Type::BenchmarkResult:return "BenchmarkResult";case boat::Type::BenchmarkEvent:return "BenchmarkEvent";case boat::Type::SyntheticData:return "SyntheticData";case boat::Type::BenchmarkAbort:return "BenchmarkAbort";case boat::Type::Reserved56:return "Reserved56";case boat::Type::Reserved57:return "Reserved57";case boat::Type::Reserved58:return "Reserved58";case boat::Type::GnssNavV2:return "GnssNavV2";case boat::Type::TimeSyncEstimate:return "TimeSyncEstimate";case boat::Type::Reserved61:return "Reserved61";case boat::Type::ControlOutput:return "ControlOutput";case boat::Type::ControlSnapshot:return "ControlSnapshot";case boat::Type::InaStatus:return "InaStatus";case boat::Type::VescTelemetry:return "VescTelemetry";case boat::Type::WaypointSet:return "WaypointSet";case boat::Type::WaypointAck:return "WaypointAck";default:return "UNKNOWN";}} uint8_t bnoDiagKindForTx(boat::Type type,const uint8_t*p,uint16_t n){if(!p||n<1)return 0;if(type==boat::Type::BnoAccel)return p[0]==1?1:0;if(type==boat::Type::BnoGyro)return p[0]==2?2:0;if(type==boat::Type::BnoQuaternion)return (p[0]==3||p[0]==5)?p[0]:0;if(type==boat::Type::BnoMagnetic)return p[0]==4?4:0;return 0;}
void resetBnoTxDiag(){portENTER_CRITICAL(&bnoMetricsMux);for(uint8_t i=0;i<6;++i)bnoTxDiag[i]={};memset(txTypeDiag,0,sizeof(txTypeDiag));memset(txHistory,0,sizeof(txHistory));txFramesCompleted=txBytesSent=txWriteCalls=txPartialWrites=txZeroWrites=0;txMaxWriteUs=0;txMinFreeHeap=ESP.getFreeHeap();txTrialFirstSequence=txTrialLastSequence=0;txTrialHasSequence=false;txCaptureSuppressed=0;++txDiagResetGeneration;portEXIT_CRITICAL(&bnoMetricsMux);}
  void resetP1BnoTimestampStats(){portENTER_CRITICAL(&bnoMetricsMux);for(uint8_t k=1;k<=5;++k)p1BnoTimestampStats[k]={};p1BnoTimestampStatsActive=false;portEXIT_CRITICAL(&bnoMetricsMux);}
  void recordP1BnoTimestamp(uint8_t kind,uint64_t sensorUs,uint64_t rxUs){if(kind<1||kind>5)return;portENTER_CRITICAL(&bnoMetricsMux);if(!p1BnoTimestampStatsActive){portEXIT_CRITICAL(&bnoMetricsMux);return;}auto&t=p1BnoTimestampStats[kind];if(!t.events){t.firstSensorUs=sensorUs;t.firstRxUs=rxUs;}else{const int64_t sensorDelta=sensorUs>=t.lastSensorUs?(int64_t)(sensorUs-t.lastSensorUs):-(int64_t)(t.lastSensorUs-sensorUs);const uint64_t rxDelta=rxUs-t.lastRxUs;if(!sensorDelta)++t.duplicates;if(sensorDelta<0)++t.reversals;t.sensorDeltaSum+=sensorDelta;t.rxDeltaSum+=rxDelta;if(t.events==1){t.sensorDeltaMin=t.sensorDeltaMax=sensorDelta;t.rxDeltaMin=t.rxDeltaMax=rxDelta;}else{if(sensorDelta<t.sensorDeltaMin)t.sensorDeltaMin=sensorDelta;if(sensorDelta>t.sensorDeltaMax)t.sensorDeltaMax=sensorDelta;if(rxDelta<t.rxDeltaMin)t.rxDeltaMin=rxDelta;if(rxDelta>t.rxDeltaMax)t.rxDeltaMax=rxDelta;}}++t.events;t.lastSensorUs=sensorUs;t.lastRxUs=rxUs;t.hasPrevious=true;portEXIT_CRITICAL(&bnoMetricsMux);}
  void printP1BnoTimestampStats(){for(uint8_t k=1;k<=5;++k){P1BnoTimestampStats t{};portENTER_CRITICAL(&bnoMetricsMux);t=p1BnoTimestampStats[k];portEXIT_CRITICAL(&bnoMetricsMux);const double d=t.events>1?(double)(t.events-1):1.0;Serial.printf("BNO_TS_TRIAL kind=%u events=%lu dup=%lu reverse=%lu sensor_dt_us=%lld/%.2f/%lld rx_dt_us=%llu/%.2f/%llu first_sensor_rx_us=%llu/%llu last_sensor_rx_us=%llu/%llu\n",(unsigned)k,(unsigned long)t.events,(unsigned long)t.duplicates,(unsigned long)t.reversals,(long long)t.sensorDeltaMin,(double)t.sensorDeltaSum/d,(long long)t.sensorDeltaMax,(unsigned long long)t.rxDeltaMin,(double)t.rxDeltaSum/d,(unsigned long long)t.rxDeltaMax,(unsigned long long)t.firstSensorUs,(unsigned long long)t.firstRxUs,(unsigned long long)t.lastSensorUs,(unsigned long long)t.lastRxUs);}}
void txHistoryAllocated(uint32_t sequence,uint8_t type,uint64_t allocatedUs,bool boundaryAck){portENTER_CRITICAL(&bnoMetricsMux);TxSequenceHistoryEntry&e=txHistory[sequence&(kTxSequenceHistoryDepth-1)];e={};e.sequence=sequence;e.type=type;e.flags=TxHistAllocated|(boundaryAck?TxHistBoundaryAck:0);e.allocatedUs=allocatedUs;portEXIT_CRITICAL(&bnoMetricsMux);}
void txHistoryPrint(){TxSequenceHistoryEntry e{};for(uint16_t i=0;i<kTxSequenceHistoryDepth;++i){portENTER_CRITICAL(&bnoMetricsMux);e=txHistory[i];portEXIT_CRITICAL(&bnoMetricsMux);if(e.sequence)Serial.printf("TX_HISTORY sequence=%lu type=%u flags=0x%02X encoded_bytes=%u allocated_us=%llu enqueue_us=%llu write_start_us=%llu write_end_us=%llu\n",(unsigned long)e.sequence,(unsigned)e.type,(unsigned)e.flags,(unsigned)e.encodedBytes,(unsigned long long)e.allocatedUs,(unsigned long long)e.enqueueUs,(unsigned long long)e.writeStartUs,(unsigned long long)e.writeEndUs);}}
void linkSendFinish(){portENTER_CRITICAL(&linkMux);if(linkSendsInFlight) --linkSendsInFlight;portEXIT_CRITICAL(&linkMux);}
uint32_t reserveLinkSequence(){portENTER_CRITICAL(&linkMux);const uint32_t s=++linkSeq;portEXIT_CRITICAL(&linkMux);return s;}
bool linkSend(boat::Type type,const uint8_t*p,uint16_t n,uint16_t flags=0,bool bypassCaptureGate=false,uint32_t forcedSequence=0){
  const uint8_t diagKind=bnoDiagKindForTx(type,p,n); const bool boundaryAck=type==boat::Type::P1Capture&&n==sizeof(boat::P1CaptureAckPayload); uint8_t encoded[boat::kMaxEncoded]{}; uint32_t sequence=0; uint64_t allocatedUs=0; uint16_t length=0; bool dropped=false;
  // BNO and loop tasks call linkSend concurrently.  Keep sequence allocation through
  // FIFO insertion atomic, otherwise N+1 can be enqueued and transmitted before N.
  portENTER_CRITICAL(&linkMux);
  if(!bypassCaptureGate&&(p1StartGate||p1StopGate)){++txCaptureSuppressed;portEXIT_CRITICAL(&linkMux);return false;}
  ++linkSendsInFlight; sequence=forcedSequence?forcedSequence:++linkSeq; allocatedUs=nowUs(); txHistoryAllocated(sequence,(uint8_t)type,allocatedUs,boundaryAck);
  if(!boundaryAck){portENTER_CRITICAL(&bnoMetricsMux);++txTypeDiag[(uint8_t)type].requested;if(diagKind)++bnoTxDiag[diagKind].sendRequests;if(p1CaptureActive){if(!txTrialHasSequence){txTrialFirstSequence=sequence;txTrialHasSequence=true;}txTrialLastSequence=sequence;}portEXIT_CRITICAL(&bnoMetricsMux);}
  length=(uint16_t)boat::encode(boat::Header{boat::kVersion,(uint8_t)type,n,sequence,bootId,allocatedUs,flags},p,encoded,sizeof(encoded));
  if(!length||linkUsed>=kLinkQueueDepth){--linkSendsInFlight;dropped=true;portEXIT_CRITICAL(&linkMux);}else{TxItem&x=linkQueue[linkHead];x.offset=0;x.length=length;x.sequence=sequence;x.type=(uint8_t)type;x.diagKind=diagKind;x.bnoFrame=diagKind!=0;x.boundaryAck=boundaryAck;memcpy(x.data,encoded,length);linkHead=(linkHead+1)%kLinkQueueDepth;linkUsed++;if(linkUsed>linkQueueHighWater)linkQueueHighWater=linkUsed;--linkSendsInFlight;portEXIT_CRITICAL(&linkMux);}
  if(dropped){portENTER_CRITICAL(&bnoMetricsMux);txHistory[sequence&(kTxSequenceHistoryDepth-1)].flags|=TxHistDrop;if(diagKind)++bnoTxDiag[diagKind].queueDrops;portEXIT_CRITICAL(&bnoMetricsMux);++linkDrops;return false;}
  portENTER_CRITICAL(&bnoMetricsMux);txHistory[sequence&(kTxSequenceHistoryDepth-1)].flags|=TxHistEnqueued;txHistory[sequence&(kTxSequenceHistoryDepth-1)].enqueueUs=nowUs();if(!boundaryAck){++txTypeDiag[(uint8_t)type].enqueued;if(diagKind)++bnoTxDiag[diagKind].queueEnqueues;}portEXIT_CRITICAL(&bnoMetricsMux);return true;
}
void linkService(){while(true){portENTER_CRITICAL(&linkMux);if(!linkUsed){portEXIT_CRITICAL(&linkMux);return;}TxItem*x=&linkQueue[linkTail];const uint16_t offset=x->offset,length=x->length;const uint32_t sequence=x->sequence;const uint8_t diagKind=x->diagKind,msgType=x->type;const bool boundaryAck=x->boundaryAck;portEXIT_CRITICAL(&linkMux);int room=linkUart.availableForWrite();if(room<=0)return;size_t remain=length-offset,want=remain<(size_t)room?remain:(size_t)room;const uint64_t writeStart=nowUs();size_t done=linkUart.write(x->data+offset,want);const uint64_t writeEnd=nowUs();portENTER_CRITICAL(&bnoMetricsMux);++txWriteCalls;txBytesSent+=done;if(!done)++txZeroWrites;if(done<want&&done)++txPartialWrites;if(txHistory[sequence&(kTxSequenceHistoryDepth-1)].sequence==sequence){auto&h=txHistory[sequence&(kTxSequenceHistoryDepth-1)];if(!h.writeStartUs)h.writeStartUs=writeStart;h.writeEndUs=writeEnd;h.encodedBytes=(uint16_t)min<uint32_t>(65535u,(uint32_t)h.encodedBytes+(uint32_t)done);if(!done)h.flags|=TxHistZero;else if(done<want)h.flags|=TxHistPartial;}if(!boundaryAck)txTypeDiag[msgType].encodedBytes+=done;if(diagKind)bnoTxDiag[diagKind].encodedBytes+=done;portEXIT_CRITICAL(&bnoMetricsMux);if(!done)return;portENTER_CRITICAL(&linkMux);x->offset+=done;const bool complete=x->offset>=x->length;if(complete){linkTail=(linkTail+1)%kLinkQueueDepth;linkUsed--;}portEXIT_CRITICAL(&linkMux);if(complete){portENTER_CRITICAL(&bnoMetricsMux);if(txHistory[sequence&(kTxSequenceHistoryDepth-1)].sequence==sequence)txHistory[sequence&(kTxSequenceHistoryDepth-1)].flags|=TxHistCompleted;if(!boundaryAck){++txFramesCompleted;++txTypeDiag[msgType].completed;if(diagKind)++bnoTxDiag[diagKind].completed;}portEXIT_CRITICAL(&bnoMetricsMux);}}}void sendTofDiagnostic(uint8_t code,uint32_t value,uint32_t flags=0){boat::BenchmarkEventPayload e{};e.campaignId=bench.campaignId;e.phaseId=bench.phaseId;e.code=code;e.status=(uint8_t)bench.status;e.value=value;e.flags=flags;e.timestampUs=nowUs();e.canonicalCrc=boat::canonicalCrc(&e,offsetof(boat::BenchmarkEventPayload,canonicalCrc));linkSend(boat::Type::BenchmarkEvent,(uint8_t*)&e,sizeof(e));}
void sendBnoPipelineDiagnostics(){const bno::PipelineMetrics p=imu.metrics();uint32_t sent=0,dropped=0;portENTER_CRITICAL(&bnoMetricsMux);sent=bnoLinkFrames;dropped=bnoLinkFrameDrops;portEXIT_CRITICAL(&bnoMetricsMux);sendTofDiagnostic(29,p.callbackEvents,p.eventQueueDrops);sendTofDiagnostic(30,((uint32_t)p.eventQueueHighWater<<16)|p.decodeErrors);sendTofDiagnostic(31,p.serviceCalls,p.maxServiceUs);sendTofDiagnostic(32,sent,dropped);}
void linkTxTask(void*){uint32_t lastHeartbeat=0;for(;;){const uint32_t now=millis();if(now-lastHeartbeat>=kControlHeartbeatIntervalMs){lastHeartbeat=now;boat::HeartbeatPayload h{now,currentLinkSequence(),(uint8_t)safety,(uint8_t)kDryRunActuators,0};linkSend(boat::Type::Heartbeat,(uint8_t*)&h,sizeof(h));}linkService();vTaskDelay(1);}}
uint16_t crc16(const uint8_t*d,size_t n){return vesc::Parser::crc16(d,n);}
void setMotorRelay(bool enabled){motorRelayEnabled=enabled;digitalWrite(kMotorRelayPin,(enabled==kMotorRelayActiveHigh)?HIGH:LOW);}
bool vescSend(const uint8_t*p,uint8_t n){if(!kPhysicalOutputCompileEnabled){(void)p;(void)n;return false;}uint16_t c=crc16(p,n);size_t written=0;written+=vescUart.write(2);written+=vescUart.write(n);written+=vescUart.write(p,n);written+=vescUart.write(c>>8);written+=vescUart.write(c);written+=vescUart.write(3);return written==static_cast<size_t>(n)+5;}
void vescDutyRaw(float duty){
  const bool moving=production_control::motorRelayRequired(duty);
  if(!kPhysicalOutputCompileEnabled||(kDryRunActuators&&moving)){setMotorRelay(false);return;}
  const float limited=moving?constrain(duty,-kVescMaxDuty,kVescMaxDuty):0.0f;
  if(moving)setMotorRelay(true);
  int32_t x=(int32_t)(limited*100000.0f);uint8_t p[5]={5,(uint8_t)(x>>24),(uint8_t)(x>>16),(uint8_t)(x>>8),(uint8_t)x};
  const bool sent=vescSend(p,5);
  if(!moving||!sent)setMotorRelay(false);
}
void safeOutputs(){
  vescTargetDuty=vescAppliedDuty=0.0f;vescRamp.stopImmediate();vescDutyRaw(0);
  if(kPhysicalOutputCompileEnabled&&pcaReady&&!competitionOutputsOff){if(pca.allOff())competitionPwmWrites+=16;else ++competitionPwmErrors;}
  competitionOutputsOff=true;competitionLeftPulseUs=competitionRightPulseUs=competitionRearPulseUs=0;servoOutput=kServoCenterUs;
}
