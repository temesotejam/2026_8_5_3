// Legacy fixed-condition benchmark support.
bool benchmarkSafeOutputs(){safeOutputs();bool pcaOff=true;if(kPhysicalOutputCompileEnabled){pcaOff=!pcaReady||pca.allOff();}return kDryRunActuators&&pcaOff;}
uint32_t benchmarkFlags(){uint32_t f=boat::BenchmarkEstimatedI2cBytes;if(kDryRunActuators)f|=boat::BenchmarkDryRun;if(kPhysicalOutputCompileEnabled&&(!pcaReady||pca.allOff()))f|=boat::BenchmarkPcaOff;if(kDryRunActuators)f|=boat::BenchmarkVescZero;if(tofReady)f|=boat::BenchmarkTofReady;if(inaReady)f|=boat::BenchmarkInaReady;return f;}
bool configureTof(uint8_t profile){uint8_t resolution=64;uint8_t hz=10;uint32_t integrationMs=50;if(profile==1){resolution=64;hz=15;integrationMs=40;}else if(profile==2){resolution=16;hz=15;integrationMs=40;}else if(profile==3){resolution=16;hz=30;integrationMs=20;}tofReady=tof.begin(kTofAddress,Wire)&&tof.setResolution(resolution)&&tof.setRangingFrequency(hz)&&tof.setRangingMode(SF_VL53L5CX_RANGING_MODE::AUTONOMOUS)&&tof.setIntegrationTime(integrationMs)&&tof.startRanging();tofResolutionActual=tofReady?tof.getResolution():0;tofHzActual=tofReady?tof.getRangingFrequency():0;tofIntegrationMsActual=tofReady?tof.getIntegrationTime():0;tofModeActual=tofReady?(uint8_t)tof.getRangingMode():0;tofI2cPacketBytes=tofReady?tof.getWireMaxPacketSize():0;tofReady=tofReady&&tofResolutionActual==resolution&&tofHzActual==hz&&tofIntegrationMsActual==integrationMs&&tofModeActual==(uint8_t)SF_VL53L5CX_RANGING_MODE::AUTONOMOUS;return tofReady;}
bool configureBenchmark(const boat::BenchmarkCommandPayload& c){if(!kDryRunActuators||!benchmarkSafeOutputs())return false;const bool fixedCondition=c.i2cClockHz==kPeripheralI2cHz&&c.inaProfile==experiment_config::kInaProfile&&c.tofProfile==experiment_config::kTofProfile&&c.uartProfile==experiment_config::kUartProfile&&c.phase==experiment_config::kPhase;bench.i2cClockHz=kPeripheralI2cHz;bench.flags=benchmarkFlags();return fixedCondition&&pcaReady&&inaReady&&tofReady;}
void sendBenchmarkReady(boat::BenchmarkStatus status){boat::BenchmarkReadyPayload r{};r.campaignId=bench.campaignId;r.phaseId=bench.phaseId;r.status=(uint8_t)status;r.safetyState=(uint8_t)safety;r.flags=bench.flags;r.runtimeI2cHz=bench.i2cClockHz;r.tofResolution=tofResolutionActual;r.tofHz=tofHzActual;r.canonicalCrc=boat::canonicalCrc(&r,offsetof(boat::BenchmarkReadyPayload,canonicalCrc));linkSend(boat::Type::BenchmarkReady,(uint8_t*)&r,sizeof(r));}
void startBenchmarkPhase(){portENTER_CRITICAL(&bnoMetricsMux);bnoTaskMaxPollUs=bnoTaskMaxRecoverUs=bnoIntEdges=bnoTaskTimeouts=bnoLinkFrames=bnoLinkFrameDrops=0;portEXIT_CRITICAL(&bnoMetricsMux);imu.resetRunStats();bnoBenchmarkActive=true;bench.active=true;bench.startMs=millis();bench.syntheticRx=bench.tofFrames=bench.tofIncomplete=bench.maxTofReadUs=bench.maxTofReadyUs=bench.maxTofServiceUs=bench.maxLinkRxUs=bench.maxImuPollUs=bench.maxImuRecoverUs=bench.maxVescUs=bench.maxLoopUs=0;bench.minFreeHeap=ESP.getFreeHeap();bench.vescReqStart=vescReq;bench.vescRespStart=vescResp;bench.vescErrStart=vescErrors;ina.resetBenchmark();sendTofDiagnostic(20,((uint32_t)tofResolutionActual<<16)|tofHzActual,tofI2cPacketBytes);sendTofDiagnostic(22,tofIntegrationMsActual,tofModeActual);}
void sendBenchmarkResult(boat::BenchmarkStatus status){bnoBenchmarkActive=false;bench.active=false;uint32_t maxBnoPollUs=0,maxBnoRecoverUs=0,intEdges=0,timeouts=0;portENTER_CRITICAL(&bnoMetricsMux);maxBnoPollUs=bnoTaskMaxPollUs;maxBnoRecoverUs=bnoTaskMaxRecoverUs;intEdges=bnoIntEdges;timeouts=bnoTaskTimeouts;portEXIT_CRITICAL(&bnoMetricsMux);sendTofDiagnostic(21,bench.maxTofReadyUs,bench.maxTofServiceUs);sendTofDiagnostic(23,bench.maxLinkRxUs,maxBnoPollUs);sendTofDiagnostic(24,maxBnoRecoverUs,bench.maxVescUs);sendTofDiagnostic(25,bench.maxLoopUs);sendTofDiagnostic(26,vescReq-bench.vescReqStart,vescResp-bench.vescRespStart);sendTofDiagnostic(27,vescErrors-bench.vescErrStart);sendTofDiagnostic(28,intEdges,timeouts);sendBnoPipelineDiagnostics();boat::BenchmarkResultPayload r{};r.campaignId=bench.campaignId;r.phaseId=bench.phaseId;r.phase=(uint8_t)bench.phase;r.status=(uint8_t)status;r.flags=benchmarkFlags();r.inaReads=ina.benchmark.attempts;r.inaFresh=ina.benchmark.fresh;r.inaDuplicates=ina.benchmark.duplicates;r.tofFrames=bench.tofFrames;r.tofIncomplete=bench.tofIncomplete;r.syntheticRx=bench.syntheticRx;r.i2cTransactions=ina.benchmark.transactions;r.i2cErrors=ina.errors;r.maxI2cUs=ina.benchmark.maxReadUs;r.maxTofReadUs=bench.maxTofReadUs;r.maxInaReadUs=ina.benchmark.maxReadUs;r.linkDrops=linkDrops;r.freeHeap=ESP.getFreeHeap();r.minFreeHeap=bench.minFreeHeap;r.durationMs=millis()-bench.startMs;r.canonicalCrc=boat::canonicalCrc(&r,offsetof(boat::BenchmarkResultPayload,canonicalCrc));linkSend(boat::Type::BenchmarkResult,(uint8_t*)&r,sizeof(r));}
void processBenchmark(const boat::Frame&f){if(f.header.length!=sizeof(boat::BenchmarkCommandPayload))return;boat::BenchmarkCommandPayload c{};memcpy(&c,f.payload,sizeof(c));if(c.canonicalCrc!=boat::canonicalCrc(&c,offsetof(boat::BenchmarkCommandPayload,canonicalCrc)))return;if((boat::BenchmarkAction)c.action==boat::BenchmarkAction::Prepare){bench={};bench.campaignId=c.campaignId;bench.phaseId=c.phaseId;bench.phase=(boat::BenchmarkPhase)c.phase;stop();bench.prepared=configureBenchmark(c);bench.status=bench.prepared?boat::BenchmarkStatus::Pass:boat::BenchmarkStatus::Fail;sendBenchmarkReady(bench.status);}else if(c.campaignId==bench.campaignId&&c.phaseId==bench.phaseId&&(boat::BenchmarkAction)c.action==boat::BenchmarkAction::Start&&bench.prepared){startBenchmarkPhase();}else if(c.campaignId==bench.campaignId&&c.phaseId==bench.phaseId&&(boat::BenchmarkAction)c.action==boat::BenchmarkAction::Stop){sendBenchmarkResult(bench.status);}else if((boat::BenchmarkAction)c.action==boat::BenchmarkAction::Abort){bench.active=false;safeOutputs();sendBenchmarkResult(boat::BenchmarkStatus::Aborted);}}
