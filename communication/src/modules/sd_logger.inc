// SD initialization, frame queue, binary serialization, writer task, and log APIs.
enum class SdTraceSource:uint8_t{Setup=1,LogStart=2,Writer=3,Summary=4,WebList=5,WebDownload=6};
enum class SdTraceOperation:uint8_t{SpiBegin=1,SdBegin=2,Mkdir=3,Exists=4,Open=5,Write=6,Flush=7,Close=8,Stream=9};
struct SdTraceEvent{uint64_t us;uint32_t recordCount;uint16_t queueUsed,requested,actual;uint8_t source,operation,ok,reserved;};
constexpr uint16_t kSdTraceDepth=128;
SdTraceEvent sdTrace[kSdTraceDepth]{};portMUX_TYPE sdTraceMux=portMUX_INITIALIZER_UNLOCKED;uint16_t sdTraceHead=0,sdTraceCount=0;uint32_t sdWriteOrdinal=0;
const char* sdTraceSourceName(uint8_t s){switch((SdTraceSource)s){case SdTraceSource::Setup:return "setup";case SdTraceSource::LogStart:return "log_start";case SdTraceSource::Writer:return "writer";case SdTraceSource::Summary:return "summary";case SdTraceSource::WebList:return "web_list";case SdTraceSource::WebDownload:return "web_download";}return "unknown";}
const char* sdTraceOperationName(uint8_t o){switch((SdTraceOperation)o){case SdTraceOperation::SpiBegin:return "spi_begin";case SdTraceOperation::SdBegin:return "sd_begin";case SdTraceOperation::Mkdir:return "mkdir";case SdTraceOperation::Exists:return "exists";case SdTraceOperation::Open:return "open";case SdTraceOperation::Write:return "write";case SdTraceOperation::Flush:return "flush";case SdTraceOperation::Close:return "close";case SdTraceOperation::Stream:return "stream";}return "unknown";}
void clearSdTrace(){portENTER_CRITICAL(&sdTraceMux);sdTraceHead=sdTraceCount=0;portEXIT_CRITICAL(&sdTraceMux);}
void traceSd(SdTraceSource source,SdTraceOperation operation,bool ok=true,uint16_t requested=0,uint16_t actual=0){SdTraceEvent e{static_cast<uint64_t>(esp_timer_get_time()),records,qUsed,requested,actual,(uint8_t)source,(uint8_t)operation,(uint8_t)(ok?1:0),0};portENTER_CRITICAL(&sdTraceMux);sdTrace[sdTraceHead]=e;sdTraceHead=(sdTraceHead+1)%kSdTraceDepth;if(sdTraceCount<kSdTraceDepth)++sdTraceCount;portEXIT_CRITICAL(&sdTraceMux);}
File traceSdOpen(const char* path,const char* mode,SdTraceSource source){File f=SD.open(path,mode);traceSd(source,SdTraceOperation::Open,(bool)f);return f;}
bool traceSdMkdir(const char* path,SdTraceSource source){const bool ok=SD.mkdir(path);traceSd(source,SdTraceOperation::Mkdir,ok);return ok;}
bool traceSdExists(const char* path,SdTraceSource source){const bool ok=SD.exists(path);traceSd(source,SdTraceOperation::Exists,ok);return ok;}
size_t traceSdWrite(File& f,const uint8_t* data,size_t requested,SdTraceSource source){const size_t actual=f.write(data,requested);const uint32_t ordinal=++sdWriteOrdinal;if(ordinal<=3||(ordinal%16)==0||actual!=requested)traceSd(source,SdTraceOperation::Write,actual==requested,(uint16_t)requested,(uint16_t)actual);return actual;}
uint64_t nowUs(); void traceSdFlush(File& f,SdTraceSource source){const uint64_t started=nowUs();f.flush();const uint32_t elapsed=(uint32_t)(nowUs()-started);if(elapsed>maxFlushUs)maxFlushUs=elapsed;traceSd(source,SdTraceOperation::Flush);}
void traceSdClose(File& f,SdTraceSource source){const uint64_t started=nowUs();f.close();const uint32_t elapsed=(uint32_t)(nowUs()-started);if(elapsed>maxCloseUs)maxCloseUs=elapsed;if(source==SdTraceSource::Writer){loggerFileClosed=true;lastFileCloseUs=nowUs();}traceSd(source,SdTraceOperation::Close);}
void dumpSdTrace(){SdTraceEvent e{};uint16_t head=0,count=0;portENTER_CRITICAL(&sdTraceMux);head=sdTraceHead;count=sdTraceCount;portEXIT_CRITICAL(&sdTraceMux);Serial.printf("SDTRACE count=%u write_calls=%lu\n",count,(unsigned long)sdWriteOrdinal);for(uint16_t i=0;i<count;++i){portENTER_CRITICAL(&sdTraceMux);e=sdTrace[(head+kSdTraceDepth-count+i)%kSdTraceDepth];portEXIT_CRITICAL(&sdTraceMux);Serial.printf("SDTRACE us=%llu src=%s op=%s ok=%u rec=%lu q=%u req=%u actual=%u\n",(unsigned long long)e.us,sdTraceSourceName(e.source),sdTraceOperationName(e.operation),e.ok,(unsigned long)e.recordCount,e.queueUsed,e.requested,e.actual);}}
void clearQueue(){portENTER_CRITICAL(&queueMux);qHead=qTail=qUsed=0;portEXIT_CRITICAL(&queueMux);}
uint8_t enqueueTaskSlot(){const char* n=pcTaskGetName(nullptr);if(!n)return 3;if(strstr(n,"UartRx"))return 1;if(strstr(n,"loop"))return 0;if(strstr(n,"SdWriter"))return 2;return 3;}
void recordEnqueueAccepted(const boat::Frame& f){++enqueueAccepted;lastEnqueueUs=f.logQueueUs;const uint8_t task=enqueueTaskSlot();if(task<4)++enqueueTaskCounts[task];++enqueueAcceptedType[f.header.type];lastEnqueueSequenceType[f.header.type]=f.header.sequence;lastEnqueueTypeUs[f.header.type]=f.logQueueUs;const uint8_t k=bnoKindForFrame(f);if(k)++enqueueAcceptedKind[k];}
void recordQueueDequeued(const boat::Frame& f){++queueDequeued;const uint64_t t=nowUs();const uint32_t wait=f.logQueueUs&&t>=f.logQueueUs?(uint32_t)min<uint64_t>(UINT32_MAX,t-f.logQueueUs):0;if(wait>maxQueueWaitUs)maxQueueWaitUs=wait;++queueDequeuedType[f.header.type];const uint8_t k=bnoKindForFrame(f);if(k)++queueDequeuedKind[k];}
void recordWrittenToBin(const boat::Frame& f){++writtenToBin;lastWriteUs=nowUs();++writtenType[f.header.type];lastWrittenSequenceType[f.header.type]=f.header.sequence;lastWrittenTypeUs[f.header.type]=lastWriteUs;const uint8_t k=bnoKindForFrame(f);if(k)++writtenKind[k];}
void dumpPendingQueue(const char* tag){uint32_t typeCount[256]{};uint32_t firstSeq[256]{},lastSeq[256]{};uint64_t firstUs[256]{},lastUs[256]{};portENTER_CRITICAL(&queueMux);const uint16_t n=qUsed;for(uint16_t i=0;i<n;++i){const boat::Frame& f=queue[(qTail+i)%kFrameQueueDepth];const uint8_t t=f.header.type;++typeCount[t];if(!firstSeq[t]){firstSeq[t]=f.header.sequence;firstUs[t]=f.logQueueUs;}lastSeq[t]=f.header.sequence;lastUs[t]=f.logQueueUs;}portEXIT_CRITICAL(&queueMux);Serial.printf("LOGGER_PENDING tag=%s q=%u\n",tag,qUsed);for(uint16_t t=0;t<256;++t)if(typeCount[t])Serial.printf("LOGGER_PENDING_TYPE tag=%s type=%u count=%lu first_seq=%lu last_seq=%lu first_enqueue_us=%llu last_enqueue_us=%llu\n",tag,(unsigned)t,(unsigned long)typeCount[t],(unsigned long)firstSeq[t],(unsigned long)lastSeq[t],(unsigned long long)firstUs[t],(unsigned long long)lastUs[t]);}
void dumpLoggerDiagnostics(){Serial.printf("LOGGER_STATE state=%s logging=%u finalizing=%u gate_closed=%u file_closed=%u active_enqueue=%lu q=%u sd_used=%u\n",loggerStateName(loggerState),logging?1:0,logFinalizing?1:0,enqueueGateClosed?1:0,loggerFileClosed?1:0,(unsigned long)activeEnqueueCount,qUsed,(unsigned)sdUsed);Serial.printf("LOGGER_COUNTERS enqueue_attempt=%llu enqueue_accepted=%llu enqueue_rejected_inactive=%llu enqueue_rejected_closing=%llu queue_dequeued=%llu written_to_bin=%llu pending_in_queue=%u pending_bin_buffer=%u writer_exit_count=%llu enqueue_after_writer_exit=%llu enqueue_after_file_close=%llu enqueue_attempt_after_writer_exit=%llu enqueue_attempt_after_file_close=%llu active_enqueue=%lu gate_closed=%u\n",(unsigned long long)enqueueAttempts,(unsigned long long)enqueueAccepted,(unsigned long long)enqueueRejectedInactive,(unsigned long long)enqueueRejectedClosing,(unsigned long long)queueDequeued,(unsigned long long)writtenToBin,qUsed,(unsigned)sdUsed,(unsigned long long)writerExitCount,(unsigned long long)enqueueAfterWriterExit,(unsigned long long)enqueueAfterFileClose,(unsigned long long)enqueueAttemptAfterWriterExit,(unsigned long long)enqueueAttemptAfterFileClose,(unsigned long)activeEnqueueCount,enqueueGateClosed?1:0);Serial.printf("LOGGER_TIMING max_queue_wait_us=%lu max_dequeue_us=%lu max_encode_us=%lu max_write_chunk_us=%lu max_partial_write_us=%lu max_flush_us=%lu max_close_us=%lu max_mutex_wait_us=%lu partial_writes=%lu zero_writes=%lu\n",(unsigned long)maxQueueWaitUs,(unsigned long)maxDequeueUs,(unsigned long)maxEncodeUs,(unsigned long)maxWriteChunkUs,(unsigned long)maxPartialWriteUs,(unsigned long)maxFlushUs,(unsigned long)maxCloseUs,(unsigned long)maxMutexWaitUs,(unsigned long)partialWriteCount,(unsigned long)zeroWriteCount);Serial.printf("LOGGER_EVENTS writer_exit_us=%llu file_close_us=%llu finalize_us=%llu last_enqueue_us=%llu last_write_us=%llu stop_ack_rx_sequence=%lu\n",(unsigned long long)lastWriterExitUs,(unsigned long long)lastFileCloseUs,(unsigned long long)lastFinalizeUs,(unsigned long long)lastEnqueueUs,(unsigned long long)lastWriteUs,(unsigned long)controlRxSequenceAtStopAck);Serial.printf("LOGGER_TASK enqueue_task loop=%lu uart_rx=%lu sd_writer=%lu other=%lu\n",(unsigned long)enqueueTaskCounts[0],(unsigned long)enqueueTaskCounts[1],(unsigned long)enqueueTaskCounts[2],(unsigned long)enqueueTaskCounts[3]);for(uint16_t t=0;t<256;++t)if(enqueueAcceptedType[t]||queueDequeuedType[t]||writtenType[t])Serial.printf("LOGGER_TYPE type=%u enqueue=%lu dequeued=%lu written=%lu\n",(unsigned)t,(unsigned long)enqueueAcceptedType[t],(unsigned long)queueDequeuedType[t],(unsigned long)writtenType[t]);for(uint8_t k=1;k<=5;++k)Serial.printf("LOGGER_BNO kind=%u enqueue=%lu dequeued=%lu written=%lu\n",(unsigned)k,(unsigned long)enqueueAcceptedKind[k],(unsigned long)queueDequeuedKind[k],(unsigned long)writtenKind[k]);}
bool enqueue(boat::Frame frame){++enqueueAttempts;frame.logQueueUs=nowUs();const LoggerState st=loggerState;if(writerExitCount)++enqueueAttemptAfterWriterExit;if(loggerFileClosed)++enqueueAttemptAfterFileClose;portENTER_CRITICAL(&queueMux);++activeEnqueueCount;if(enqueueGateClosed||(!logging&&!logFinalizing)){++enqueueRejectedInactive;if(st==LoggerState::ClosingInput||st==LoggerState::Draining||st==LoggerState::Finalizing)++enqueueRejectedClosing;--activeEnqueueCount;portEXIT_CRITICAL(&queueMux);return false;}if(qUsed>=kFrameQueueDepth){++queueDrops;--activeEnqueueCount;portEXIT_CRITICAL(&queueMux);return false;}queue[qHead]=frame;qHead=(qHead+1)%kFrameQueueDepth;++qUsed;if(qUsed>qHigh)qHigh=qUsed;if(writerExitCount)++enqueueAfterWriterExit;if(loggerFileClosed)++enqueueAfterFileClose;recordEnqueueAccepted(frame);--activeEnqueueCount;portEXIT_CRITICAL(&queueMux);if(logTaskHandle)xTaskNotifyGive(logTaskHandle);return true;}
bool dequeue(boat::Frame& frame){const uint64_t started=nowUs();portENTER_CRITICAL(&queueMux);if(!qUsed){portEXIT_CRITICAL(&queueMux);return false;}frame=queue[qTail];qTail=(qTail+1)%kFrameQueueDepth;--qUsed;portEXIT_CRITICAL(&queueMux);const uint32_t elapsed=(uint32_t)(nowUs()-started);if(elapsed>maxDequeueUs)maxDequeueUs=elapsed;recordQueueDequeued(frame);return true;}
bool commit(){if(!sdUsed)return true;size_t offset=0;while(offset<sdUsed){size_t n=min(kSdWriteChunkBytes,sdUsed-offset);const uint64_t started=nowUs();const size_t actual=traceSdWrite(logFile,sdBuffer+offset,n,SdTraceSource::Writer);const uint32_t elapsed=(uint32_t)(nowUs()-started);if(actual>0&&actual<n){++partialWriteCount;if(elapsed>maxPartialWriteUs)maxPartialWriteUs=elapsed;}if(actual==0)++zeroWriteCount;if(elapsed>maxWriteChunkUs)maxWriteChunkUs=elapsed;if(actual!=n){++sdErrors;snprintf(fault,sizeof(fault),"SD write failed");sdUsed=0;return false;}offset+=n;}sdUsed=0;return true;}
bool appendBinRecord(const boat::Frame& frame,uint64_t receivedUs);

bool append(const void* data,size_t n){const auto* p=static_cast<const uint8_t*>(data);while(n){size_t part=min(n,sizeof(sdBuffer)-sdUsed);memcpy(sdBuffer+sdUsed,p,part);sdUsed+=part;p+=part;n-=part;if(sdUsed==sizeof(sdBuffer)&&!commit())return false;}return true;}
void setBnoCapture(bool enabled);void writeSummary(){if(!sdReady||!strcmp(runName,"none"))return;char path[32];snprintf(path,sizeof(path),"%s/%s",kLogDirectory,runName);char* e=strstr(path,".BIN");if(!e)return;memcpy(e,".TXT",5);File f=traceSdOpen(path,FILE_WRITE,SdTraceSource::Summary);if(!f){++sdErrors;return;}f.printf("firmware=%s\nversion=%s\nnormal_stop=1\nrecords=%lu\nqueue_drops=%lu\nqueue_high_water=%u\nsd_write_errors=%lu\ncontrol_frames=%lu\ncontrol_crc_errors=%lu\ncontrol_cobs_errors=%lu\ncontrol_length_errors=%lu\ngnss_nav_tx=%lu\n",kFirmwareName,kFirmwareVersion,(unsigned long)records,(unsigned long)queueDrops,qHigh,(unsigned long)sdErrors,(unsigned long)controlFrames,(unsigned long)crcErrors,(unsigned long)cobsErrors,(unsigned long)lengthErrors,(unsigned long)navTx);traceSd(SdTraceSource::Summary,SdTraceOperation::Write);traceSdClose(f,SdTraceSource::Summary);}
void stopLog(){if(!logging)return;loggerState=LoggerState::StopRequested;if(bnoCaptureActive)setBnoCapture(false);logging=false;logStopDeadlineUs=0;logFinalizing=true;logFinalizeRequested=true;if(!stopAckPending){stopAckDeadlineUs=nowUs();closeEnqueueGate(LoggerState::Draining);}if(logTaskHandle)xTaskNotifyGive(logTaskHandle);}
bool startLog(uint32_t durationS=0){if(!sdReady||logging||logFinalizing)return false;clearSdTrace();sdWriteOrdinal=0;traceSdMkdir(kLogDirectory,SdTraceSource::LogStart);for(uint16_t n=1;n<10000;++n){snprintf(runName,sizeof(runName),"RUN%04u.BIN",n);char path[32];snprintf(path,sizeof(path),"%s/%s",kLogDirectory,runName);if(!traceSdExists(path,SdTraceSource::LogStart)){logFile=traceSdOpen(path,FILE_WRITE,SdTraceSource::LogStart);break;}}if(!logFile){snprintf(fault,sizeof(fault),"log open failed");return false;}records=queueDrops=sdErrors=controlFrames=0;qHigh=0;loggerState=LoggerState::Running;loggerFileClosed=false;enqueueGateClosed=false;activeEnqueueCount=0;enqueueAttempts=enqueueAccepted=enqueueRejectedInactive=enqueueRejectedClosing=queueDequeued=writtenToBin=writerExitCount=enqueueAfterWriterExit=enqueueAfterFileClose=enqueueAttemptAfterWriterExit=enqueueAttemptAfterFileClose=0;memset(enqueueTaskCounts,0,sizeof(enqueueTaskCounts));memset(enqueueAcceptedType,0,sizeof(enqueueAcceptedType));memset(queueDequeuedType,0,sizeof(queueDequeuedType));memset(writtenType,0,sizeof(writtenType));memset(lastEnqueueSequenceType,0,sizeof(lastEnqueueSequenceType));memset(lastWrittenSequenceType,0,sizeof(lastWrittenSequenceType));memset(lastEnqueueTypeUs,0,sizeof(lastEnqueueTypeUs));memset(lastWrittenTypeUs,0,sizeof(lastWrittenTypeUs));memset(enqueueAcceptedKind,0,sizeof(enqueueAcceptedKind));memset(queueDequeuedKind,0,sizeof(queueDequeuedKind));memset(writtenKind,0,sizeof(writtenKind));lastWriterExitUs=lastFileCloseUs=lastFinalizeUs=lastEnqueueUs=lastWriteUs=0;maxQueueWaitUs=maxDequeueUs=maxEncodeUs=maxWriteChunkUs=maxPartialWriteUs=maxFlushUs=maxCloseUs=maxMutexWaitUs=partialWriteCount=zeroWriteCount=0;controlRxSequenceAtStopAck=0;trialFirstSequence=trialLastSequence=0;trialHasSequence=false;trialTargetActive=false;trialExpectedFirstSequence=trialExpectedLastSequence=trialStartAckSequence=trialStopAckSequence=0;stopAckPending=false;stopAckReceived=false;stopAckDeadlineUs=0;clearSequenceGapHistory();clearQueue();logFinalizeRequested=false;logFinalizing=false;snprintf(fault,sizeof(fault),"none");logStartUs=nowUs();logStopDeadlineUs=durationS?logStartUs+(uint64_t)durationS*1000000ULL:0;logging=true;captureRxTrialBaseline();printRxTrial("START");return true;}
bool loggerDrainReady(){bool ready=false;portENTER_CRITICAL(&queueMux);ready=enqueueGateClosed&&activeEnqueueCount==0&&qUsed==0;portEXIT_CRITICAL(&queueMux);return ready&&sdUsed==0;}
void logTask(void*){for(;;){ulTaskNotifyTake(pdTRUE,pdMS_TO_TICKS(10));const bool finalizing=logFinalizeRequested;if(!logging&&!finalizing)continue;if(finalizing&&loggerState!=LoggerState::Finalized&&loggerState!=LoggerState::Error)loggerState=LoggerState::Draining;const uint64_t sdStartUs=nowUs();const uint64_t mutexStart=nowUs();if(sdMutex)xSemaphoreTake(sdMutex,portMAX_DELAY);const uint32_t mutexWait=(uint32_t)(nowUs()-mutexStart);if(mutexWait>maxMutexWaitUs)maxMutexWaitUs=mutexWait;boat::Frame frame{};uint16_t written=0;const uint16_t limit=finalizing?UINT16_MAX:24;while(written<limit&&dequeue(frame)){const uint64_t t=frame.logQueueUs?frame.logQueueUs:nowUs();const uint64_t encodeStart=nowUs();const bool ok=appendBinRecord(frame,t);const uint32_t encodeElapsed=(uint32_t)(nowUs()-encodeStart);if(encodeElapsed>maxEncodeUs)maxEncodeUs=encodeElapsed;if(!ok){logging=false;logFinalizeRequested=true;logFinalizing=true;enqueueGateClosed=true;loggerState=LoggerState::Error;snprintf(fault,sizeof(fault),"SD write failed");break;}recordWrittenToBin(frame);++records;++written;}bool waitForStopAck=false;if(logFinalizeRequested){if(stopAckPending&&!stopAckReceived){if(nowUs()>=stopAckDeadlineUs){Serial.printf("TRIAL_STOP_ACK_TIMEOUT expected_last=%lu\n",(unsigned long)trialExpectedLastSequence);closeEnqueueGate(LoggerState::Error);}else waitForStopAck=true;}else if(!enqueueGateClosed)closeEnqueueGate(LoggerState::Draining);commit();if(!waitForStopAck&&loggerDrainReady()){if(loggerState!=LoggerState::Error)loggerState=LoggerState::Finalizing;if(logFile){traceSdFlush(logFile,SdTraceSource::Writer);traceSdClose(logFile,SdTraceSource::Writer);++writerExitCount;lastWriterExitUs=nowUs();}writeSummary();dumpSdTrace();dumpPendingQueue("BEFORE_CLOSE");dumpLoggerDiagnostics();vTaskDelay(pdMS_TO_TICKS(100));printRxTrial("END");lastFinalizeUs=nowUs();logFinalizeRequested=false;logFinalizing=false;stopAckPending=false;if(loggerState!=LoggerState::Error)loggerState=LoggerState::Finalized;dumpPendingQueue("AFTER_FINALIZE");Serial.printf("LOGGER_FINAL state=%s q=%u sd_used=%u writer_exit_count=%llu file_closed=%u\n",loggerStateName(loggerState),qUsed,(unsigned)sdUsed,(unsigned long long)writerExitCount,loggerFileClosed?1:0);}}if(sdMutex)xSemaphoreGive(sdMutex);const uint32_t sdElapsedUs=(uint32_t)(nowUs()-sdStartUs);if(sdElapsedUs>sdTaskMaxProcessUs)sdTaskMaxProcessUs=sdElapsedUs;if(waitForStopAck)vTaskDelay(pdMS_TO_TICKS(10));else vTaskDelay(pdMS_TO_TICKS(1));}}void emitLocal(boat::Type type,const void* payload,uint16_t length){if(!logging||length>boat::kMaxPayload)return;boat::Frame f{};f.header={boat::kVersion,(uint8_t)type,length,++localSeq,bootId,nowUs(),1};if(length)memcpy(f.payload,payload,length);enqueue(f);}
bool appendBinRecord(const boat::Frame& frame, uint64_t receivedUs){uint8_t record[boat_bin::kMaxRecordBytes]{};size_t written=0;if(!boat_bin::serializeRecord(frame.header,receivedUs,frame.payload,frame.header.length,record,sizeof(record),written))return false;return append(record,written);}
void apiLogStop(){stopLog();web.send(200,"application/json","{\"logging\":false}");} void apiLogFiles(){if(logging||logFinalizing){web.send(409,"application/json","{\"error\":\"log_active\"}");return;}String b="{\"sd_ready\":"+String(sdReady?"true":"false")+",\"logging\":false,\"files\":[";bool first=true;if(sdReady){File dir=traceSdOpen(kLogDirectory,FILE_READ,SdTraceSource::WebList);if(dir){for(File f=dir.openNextFile();f;f=dir.openNextFile()){if(!first)b+=",";first=false;b+="{\"name\":\""+String(f.name())+"\",\"size\":"+String((unsigned long)f.size())+"}";traceSdClose(f,SdTraceSource::WebList);}traceSdClose(dir,SdTraceSource::WebList);}}b+="]}";web.send(200,"application/json",b);} bool safeLogName(const String& n){return n.length()==11&&n.startsWith("RUN")&&(n.endsWith(".BIN")||n.endsWith(".TXT"));} void apiLogDownload(){if(logging||logFinalizing){web.send(409,"application/json","{\"error\":\"log_active\"}");return;}const String n=web.arg("name");if(!safeLogName(n)){web.send(400,"application/json","{\"error\":\"invalid_name\"}");return;}const String path=String(kLogDirectory)+"/"+n;File f=traceSdOpen(path.c_str(),FILE_READ,SdTraceSource::WebDownload);if(!f){web.send(404,"application/json","{\"error\":\"not_found\"}");return;}traceSd(SdTraceSource::WebDownload,SdTraceOperation::Stream);web.streamFile(f,n.endsWith(".TXT")?"text/plain":"application/octet-stream");traceSdClose(f,SdTraceSource::WebDownload);}
