// Control-XIAO UART framing, receive dispatch, command TX, time sync, and diagnostics.
enum class UartRxDiagMode:uint8_t{Dispatch=0,Raw=1,DecodeCount=2,DispatchNoBnoEnqueue=3}; UartRxDiagMode uartRxDiagMode=UartRxDiagMode::Dispatch; const char* uartRxDiagModeName(){switch(uartRxDiagMode){case UartRxDiagMode::Raw:return "raw";case UartRxDiagMode::DecodeCount:return "decode_count";case UartRxDiagMode::DispatchNoBnoEnqueue:return "dispatch_no_bno_enqueue";default:return "dispatch";}}
struct ProductionCache {
  boat::ControlOutputPayload output{};
  boat::ControlSnapshotPayload snapshot{};
  boat::InaStatusPayload power{};
  boat::VescTelemetryPayload motor{};
  boat::ActuatorStatePayload actuators{};
  boat::SystemHealthPayload health{};
  boat::WaypointAckPayload waypointAck{};
  bool hasOutput=false,hasSnapshot=false,hasPower=false,hasMotor=false;
  bool hasActuators=false,hasHealth=false,hasWaypointAck=false;
  uint64_t updatedUs=0;
} production;
struct TypeStat { uint32_t count=0,lastSequence=0; uint16_t lastLength=0; uint64_t lastUs=0,encodedBytes=0; bool lengthMatch=false; };
TypeStat rxTypeStats[256]{};
struct TimeSyncDiag { uint32_t requests=0,replies=0,timeouts=0,unexpectedReplies=0; uint32_t pendingSequence=0; uint64_t pendingT1Us=0; bool pending=false; } timeSyncDiag;
uint16_t expectedPayloadLength(uint8_t type){switch((boat::Type)type){case boat::Type::BnoAccel:case boat::Type::BnoGyro:case boat::Type::BnoQuaternion:case boat::Type::BnoMagnetic:return sizeof(boat::BnoPayload);case boat::Type::TofFrame:return 196;case boat::Type::GnssProcessResult:return sizeof(boat::GnssProcessResultPayload);case boat::Type::EstimatedState:return sizeof(boat::EstimatedStatePayload);case boat::Type::PrimaryImuSnapshot:return sizeof(boat::PrimaryImuSnapshotPayload);case boat::Type::Heartbeat:return sizeof(boat::HeartbeatPayload);case boat::Type::TimeSyncReply:return sizeof(boat::TimeSyncReplyPayload);case boat::Type::CommandAck:return sizeof(boat::CommandAckPayload);case boat::Type::ControlOutput:return sizeof(boat::ControlOutputPayload);case boat::Type::ControlSnapshot:return sizeof(boat::ControlSnapshotPayload);case boat::Type::InaStatus:return sizeof(boat::InaStatusPayload);case boat::Type::VescTelemetry:return sizeof(boat::VescTelemetryPayload);case boat::Type::ActuatorState:return sizeof(boat::ActuatorStatePayload);case boat::Type::SystemHealth:return sizeof(boat::SystemHealthPayload);case boat::Type::WaypointSet:return sizeof(boat::WaypointSetPayload);case boat::Type::WaypointAck:return sizeof(boat::WaypointAckPayload);case boat::Type::ControlCommandAck:return sizeof(boat::ControlCommandAckPayload);case boat::Type::P1Capture:return sizeof(boat::P1CaptureAckPayload);default:return 0;}}
  bool isBnoType(uint8_t type){return (boat::Type)type==boat::Type::BnoAccel||(boat::Type)type==boat::Type::BnoGyro||(boat::Type)type==boat::Type::BnoQuaternion||(boat::Type)type==boat::Type::BnoMagnetic;}
  uint8_t bnoKindForFrame(const boat::Frame& f){if(!isBnoType(f.header.type)||f.header.length!=sizeof(boat::BnoPayload))return 0; if((boat::Type)f.header.type==boat::Type::BnoAccel)return f.payload[0]==1?1:0; if((boat::Type)f.header.type==boat::Type::BnoGyro)return f.payload[0]==2?2:0; if((boat::Type)f.header.type==boat::Type::BnoMagnetic)return f.payload[0]==4?4:0; return (f.payload[0]==3||f.payload[0]==5)?f.payload[0]:0;}
  void captureRxTrialBaseline(); void clearSequenceGapHistory(){portENTER_CRITICAL(&sequenceGapMux);sequenceGapHistoryHead=sequenceGapHistoryCount=0;sequenceGapHistoryTotal=0;portEXIT_CRITICAL(&sequenceGapMux);}
void recordSequenceGap(uint32_t previousSequence,uint32_t nextSequence,uint32_t missingCount,uint8_t previousType,uint8_t nextType,uint32_t decoderUs,uint32_t rxTaskUs,uint16_t rxBuffered,uint64_t eventUs){if(!missingCount)return;SequenceGapEvent e{};e.previousSequence=previousSequence;e.nextSequence=nextSequence;e.missingFirst=previousSequence+1;e.missingLast=nextSequence-1;e.missingCount=missingCount;e.previousType=previousType;e.nextType=nextType;e.decoderUs=decoderUs;e.rxTaskUs=rxTaskUs;e.rxBuffered=rxBuffered;e.eventUs=eventUs;e.elapsedUs=logStartUs?eventUs-logStartUs:0;portENTER_CRITICAL(&sequenceGapMux);e.ordinal=++sequenceGapHistoryTotal;sequenceGapHistory[sequenceGapHistoryHead]=e;sequenceGapHistoryHead=(sequenceGapHistoryHead+1)%kSequenceGapHistoryDepth;if(sequenceGapHistoryCount<kSequenceGapHistoryDepth)++sequenceGapHistoryCount;portEXIT_CRITICAL(&sequenceGapMux);}
void printSequenceGapHistory(uint32_t fromOrdinal){SequenceGapEvent e{};uint16_t head=0,count=0;portENTER_CRITICAL(&sequenceGapMux);head=sequenceGapHistoryHead;count=sequenceGapHistoryCount;portEXIT_CRITICAL(&sequenceGapMux);for(uint16_t i=0;i<count;++i){portENTER_CRITICAL(&sequenceGapMux);e=sequenceGapHistory[(head+kSequenceGapHistoryDepth-count+i)%kSequenceGapHistoryDepth];portEXIT_CRITICAL(&sequenceGapMux);if(e.ordinal>fromOrdinal)Serial.printf("SEQUENCE_GAP ordinal=%lu event_us=%llu elapsed_us=%llu prev=%lu next=%lu missing_first=%lu missing_last=%lu missing_count=%lu prev_type=%u next_type=%u rx_buffered=%u decoder_us=%lu rx_task_us=%lu\n",(unsigned long)e.ordinal,(unsigned long long)e.eventUs,(unsigned long long)e.elapsedUs,(unsigned long)e.previousSequence,(unsigned long)e.nextSequence,(unsigned long)e.missingFirst,(unsigned long)e.missingLast,(unsigned long)e.missingCount,(unsigned)e.previousType,(unsigned)e.nextType,(unsigned)e.rxBuffered,(unsigned long)e.decoderUs,(unsigned long)e.rxTaskUs);}}
struct BnoTimestampExtension{uint32_t lastRaw=0;uint32_t wraps=0;bool valid=false;} bnoTimestampExtension[6]; uint64_t extendBnoTimestamp(uint8_t kind,uint64_t raw){if(kind>=6)return raw;auto& e=bnoTimestampExtension[kind];const uint32_t low=(uint32_t)raw;if(e.valid&&low<e.lastRaw&&(e.lastRaw-low)>0x80000000UL)++e.wraps;e.lastRaw=low;e.valid=true;return (uint64_t(e.wraps)<<32)|low;} void resetCoreBnoArrival(){for(uint8_t k=0;k<6;++k){coreBnoArrival[k]=CoreBnoArrivalStats{};bnoTimestampExtension[k]=BnoTimestampExtension{};}} void updateCoreBnoArrival(uint8_t kind,uint64_t rxUs){if(kind<1||kind>5)return;auto&s=coreBnoArrival[kind];if(s.count){const uint64_t d=rxUs-s.lastUs;const uint32_t delta=d>UINT32_MAX?UINT32_MAX:(uint32_t)d;s.deltaSum+=d;if(delta<s.deltaMin)s.deltaMin=delta;if(delta>s.deltaMax)s.deltaMax=delta;}else s.firstUs=rxUs;s.lastUs=rxUs;++s.count;} void printCoreBnoArrival(){for(uint8_t k=1;k<=5;++k){const auto&s=coreBnoArrival[k];const double avg=s.count>1?(double)s.deltaSum/(double)(s.count-1):0.0;Serial.printf("BNO_CORE_TS kind=%u count=%lu first_rx_us=%llu last_rx_us=%llu delta_us=%lu/%.2f/%lu\n",(unsigned)k,(unsigned long)s.count,(unsigned long long)s.firstUs,(unsigned long long)s.lastUs,(unsigned long)(s.count>1?s.deltaMin:0),avg,(unsigned long)(s.count>1?s.deltaMax:0));}} bool isP1CaptureAck(const boat::Frame&f){return (boat::Type)f.header.type==boat::Type::P1Capture&&f.header.length==sizeof(boat::P1CaptureAckPayload);}
void closeEnqueueGate(LoggerState next){portENTER_CRITICAL(&queueMux);enqueueGateClosed=true;loggerState=next;portEXIT_CRITICAL(&queueMux);}
void handleP1CaptureAck(const boat::Frame&f){boat::P1CaptureAckPayload ack{};memcpy(&ack,f.payload,sizeof(ack));if(ack.status!=1)return;if((boat::P1CaptureAction)ack.action==boat::P1CaptureAction::Start){trialTargetActive=true;trialExpectedFirstSequence=ack.firstSequence;trialExpectedLastSequence=0;trialStartAckSequence=f.header.sequence;trialFirstSequence=trialLastSequence=0;trialHasSequence=false;resetCoreBnoArrival();captureRxTrialBaseline();Serial.printf("TRIAL_START_ACK ack_sequence=%lu first_sequence=%lu capture_id=%lu\n",(unsigned long)f.header.sequence,(unsigned long)ack.firstSequence,(unsigned long)ack.captureId);}else if((boat::P1CaptureAction)ack.action==boat::P1CaptureAction::Stop){trialExpectedLastSequence=ack.lastSequence;trialStopAckSequence=f.header.sequence;controlRxSequenceAtStopAck=f.header.sequence;stopAckReceived=true;trialTargetActive=false;closeEnqueueGate(LoggerState::Draining);Serial.printf("TRIAL_STOP_ACK ack_sequence=%lu last_sequence=%lu capture_id=%lu\n",(unsigned long)f.header.sequence,(unsigned long)ack.lastSequence,(unsigned long)ack.captureId);}}void captureRxTrialBaseline(){rxTrial.rxBytes=controlRxBytes;rxTrial.serviceBytes=controlServiceBytesTotal;rxTrial.frames=controlFrames;rxTrial.bnoValid=bnoValidFrames;rxTrial.sequenceGaps=controlSequenceGaps;rxTrial.crc=crcErrors;rxTrial.cobs=cobsErrors;rxTrial.length=lengthErrors;rxTrial.unknown=unknownTypeFrames;rxTrial.bnoInvalid=bnoInvalidKindFrames;rxTrial.rxFull=controlRxBufferFullObservations;rxTrial.serviceCalls=controlServiceCalls;rxTrial.readCalls=controlReadCalls;rxTrial.zeroReads=controlZeroReadCalls;rxTrial.delimiters=controlCobsDelimiters;rxTrial.gapHistoryTotal=sequenceGapHistoryTotal;for(uint8_t k=0;k<6;++k)rxTrial.bnoKind[k]=bnoKindFrames[k];for(uint16_t i=0;i<256;++i){rxTrial.typeCount[i]=rxTypeStats[i].count;rxTrial.typeBytes[i]=rxTypeStats[i].encodedBytes;}rxTrial.valid=true;}
    const char* typeName(uint8_t type); void printRxTrialTypes(); void printRxTrial(const char* tag){const auto d=[](uint64_t v,uint64_t b)->uint64_t{return v>=b?v-b:v;};Serial.printf("TRIAL_%s mode=%s rx_bytes=%llu service_bytes=%llu frames=%llu bno_valid=%llu seq_gap=%llu crc/cobs/len=%llu/%llu/%llu unknown=%llu bno_invalid=%llu rxbuf_full=%llu service_calls=%llu read_calls=%llu zero_reads=%llu delimiters=%llu bno_kind=%llu/%llu/%llu/%llu/%llu bno_log_enqueue=%u\n",tag,uartRxDiagModeName(),(unsigned long long)d(controlRxBytes,rxTrial.rxBytes),(unsigned long long)d(controlServiceBytesTotal,rxTrial.serviceBytes),(unsigned long long)d(controlFrames,rxTrial.frames),(unsigned long long)d(bnoValidFrames,rxTrial.bnoValid),(unsigned long long)d(controlSequenceGaps,rxTrial.sequenceGaps),(unsigned long long)d(crcErrors,rxTrial.crc),(unsigned long long)d(cobsErrors,rxTrial.cobs),(unsigned long long)d(lengthErrors,rxTrial.length),(unsigned long long)d(unknownTypeFrames,rxTrial.unknown),(unsigned long long)d(bnoInvalidKindFrames,rxTrial.bnoInvalid),(unsigned long long)d(controlRxBufferFullObservations,rxTrial.rxFull),(unsigned long long)d(controlServiceCalls,rxTrial.serviceCalls),(unsigned long long)d(controlReadCalls,rxTrial.readCalls),(unsigned long long)d(controlZeroReadCalls,rxTrial.zeroReads),(unsigned long long)d(controlCobsDelimiters,rxTrial.delimiters),(unsigned long long)d(bnoKindFrames[1],rxTrial.bnoKind[1]),(unsigned long long)d(bnoKindFrames[2],rxTrial.bnoKind[2]),(unsigned long long)d(bnoKindFrames[3],rxTrial.bnoKind[3]),(unsigned long long)d(bnoKindFrames[4],rxTrial.bnoKind[4]),(unsigned long long)d(bnoKindFrames[5],rxTrial.bnoKind[5]),bnoLogEnqueue?1:0);printRxTrialTypes();Serial.printf("TRIAL_SEQUENCE first=%lu last=%lu valid=%d\n",(unsigned long)trialFirstSequence,(unsigned long)trialLastSequence,trialHasSequence?1:0);Serial.printf("TRIAL_BOUNDARY start_ack=%lu expected_first=%lu stop_ack=%lu expected_last=%lu stop_ack_received=%d\n",(unsigned long)trialStartAckSequence,(unsigned long)trialExpectedFirstSequence,(unsigned long)trialStopAckSequence,(unsigned long)trialExpectedLastSequence,stopAckReceived?1:0);printSequenceGapHistory(rxTrial.gapHistoryTotal);printCoreBnoArrival();Serial.printf("SEQUENCE_STATE gaps=%lu duplicates=%lu out_of_order=%lu wraps=%lu\n",(unsigned long)(controlSequenceGaps-rxTrial.sequenceGaps),(unsigned long)controlSequenceDuplicates,(unsigned long)controlSequenceOutOfOrder,(unsigned long)controlSequenceWraps);}void printRxTrialTypes(){for(uint16_t i=0;i<256;++i){const uint32_t count=rxTypeStats[i].count,base=rxTrial.typeCount[i];const uint64_t bytes=rxTypeStats[i].encodedBytes,baseBytes=rxTrial.typeBytes[i];if(count>base||bytes>baseBytes)Serial.printf("TRIALTYPE type=%u name=%s frames=%lu encoded_bytes=%llu\n",(unsigned)i,typeName((uint8_t)i),(unsigned long)(count-base),(unsigned long long)(rxTypeStats[i].encodedBytes-rxTrial.typeBytes[i]));}} const char* typeName(uint8_t type){switch((boat::Type)type){case boat::Type::Heartbeat:return "Heartbeat";case boat::Type::BnoAccel:return "BnoAccel";case boat::Type::BnoGyro:return "BnoGyro";case boat::Type::BnoQuaternion:return "BnoQuaternion";case boat::Type::BnoMagnetic:return "BnoMagnetic";case boat::Type::TofFrame:return "TofFrame";case boat::Type::VescStatus:return "VescStatus";case boat::Type::ActuatorState:return "ActuatorState";case boat::Type::SystemHealth:return "SystemHealth";case boat::Type::GnssProcessResult:return "GnssProcessResult";case boat::Type::EstimatedState:return "EstimatedState";case boat::Type::PrimaryImuSnapshot:return "PrimaryImuSnapshot";case boat::Type::TimeSyncReply:return "TimeSyncReply";case boat::Type::Reserved56:return "Reserved56";case boat::Type::Reserved57:return "Reserved57";case boat::Type::Reserved58:return "Reserved58";case boat::Type::CommandAck:return "CommandAck";case boat::Type::ControlOutput:return "ControlOutput";case boat::Type::ControlSnapshot:return "ControlSnapshot";case boat::Type::InaStatus:return "InaStatus";case boat::Type::VescTelemetry:return "VescTelemetry";case boat::Type::WaypointSet:return "WaypointSet";case boat::Type::WaypointAck:return "WaypointAck";case boat::Type::P1Capture:return "P1Capture";default:return "UNKNOWN";}}
void updateTypeStat(const boat::Frame& f,uint32_t encodedBytes){auto& s=rxTypeStats[f.header.type];++s.count;s.encodedBytes+=encodedBytes;s.lastSequence=f.header.sequence;s.lastLength=f.header.length;s.lastUs=f.uartRxUs;const uint16_t expected=expectedPayloadLength(f.header.type);s.lengthMatch=!expected||expected==f.header.length;}
bool sendControl(boat::Type type,const void* payload,uint16_t length){boat::Header h{boat::kVersion,(uint8_t)type,length,++controlSeq,bootId,nowUs(),0};uint8_t out[boat::kMaxEncoded];size_t n=boat::encode(h,static_cast<const uint8_t*>(payload),out,sizeof(out));return n&&controlUart.write(out,n)==n;} void setBnoCapture(bool enabled){if(enabled==bnoCaptureActive)return;boat::P1CapturePayload p{};p.captureId=++controlSeq;p.action=(uint8_t)(enabled?boat::P1CaptureAction::Start:boat::P1CaptureAction::Stop);if(sendControl(boat::Type::P1Capture,&p,sizeof(p))){bnoCaptureActive=enabled;if(enabled){stopAckPending=false;stopAckReceived=false;}else{stopAckPending=true;stopAckReceived=false;stopAckDeadlineUs=nowUs()+1500000ULL;}emitLocal(boat::Type::P1Capture,&p,sizeof(p));}}
size_t writeCompetitionWire(const uint8_t* data,size_t length,void*){return controlUart.write(data,length);}
void initCommandCounters(){Preferences p;p.begin("boatcmd",false);uint32_t request=p.getUInt("request_next",esp_random()|1U),sequence=p.getUInt("sequence_next",esp_random()|1U);if(!request)request=1;if(!sequence)sequence=1;constexpr uint32_t reserve=256;commandRequestNext=request;commandSequenceNext=sequence;p.putUInt("request_next",request+reserve);p.putUInt("sequence_next",sequence+reserve);p.end();}
uint32_t nextCommandRequestId(){return commandRequestNext++;} uint32_t nextCommandSequence(){return commandSequenceNext++;}
void serviceCompetitionCommands(){const uint64_t now=nowUs();if(manualInputUs&&!manualInputStale&&now-manualInputUs>300000ULL){manualInputStale=true;if(commandMutex)xSemaphoreTake(commandMutex,portMAX_DELAY);competitionCommands.noteManualInputStale();if(commandMutex)xSemaphoreGive(commandMutex);}if(commandMutex)xSemaphoreTake(commandMutex,portMAX_DELAY);competitionCommands.service(now,writeCompetitionWire,nullptr);if(commandMutex)xSemaphoreGive(commandMutex);}
bool queueCompetitionMode(uint8_t mode,uint32_t& requestId,uint32_t& sequence){requestId=nextCommandRequestId();sequence=nextCommandSequence();if(commandMutex)xSemaphoreTake(commandMutex,portMAX_DELAY);const bool ok=competitionCommands.queueMode(mode,requestId,sequence,++controlSeq,nowUs(),bootId);if(commandMutex)xSemaphoreGive(commandMutex);return ok;}
bool queueCompetitionManual(float left,float right,float rear,float propulsion,uint32_t& requestId,uint32_t& sequence){if(commandMutex)xSemaphoreTake(commandMutex,portMAX_DELAY);const bool busy=competitionCommands.hasPendingManual();if(commandMutex)xSemaphoreGive(commandMutex);if(busy)return false;requestId=nextCommandRequestId();sequence=nextCommandSequence();if(commandMutex)xSemaphoreTake(commandMutex,portMAX_DELAY);const bool ok=competitionCommands.queueManual(left,right,rear,propulsion,requestId,sequence,++controlSeq,nowUs(),bootId);if(commandMutex)xSemaphoreGive(commandMutex);if(ok){manualInputUs=nowUs();manualInputStale=false;}return ok;}
void cacheFrame(const boat::Frame& f){
  portENTER_CRITICAL(&cacheMux);
  const boat::Type type=static_cast<boat::Type>(f.header.type);
  if(type==boat::Type::ControlOutput&&f.header.length==sizeof(production.output)){memcpy(&production.output,f.payload,sizeof(production.output));production.hasOutput=true;production.updatedUs=f.uartRxUs;}
  else if(type==boat::Type::ControlSnapshot&&f.header.length==sizeof(production.snapshot)){memcpy(&production.snapshot,f.payload,sizeof(production.snapshot));production.hasSnapshot=true;production.updatedUs=f.uartRxUs;}
  else if(type==boat::Type::InaStatus&&f.header.length==sizeof(production.power)){memcpy(&production.power,f.payload,sizeof(production.power));production.hasPower=true;}
  else if(type==boat::Type::VescTelemetry&&f.header.length==sizeof(production.motor)){memcpy(&production.motor,f.payload,sizeof(production.motor));production.hasMotor=true;}
  else if(type==boat::Type::ActuatorState&&f.header.length==sizeof(production.actuators)){memcpy(&production.actuators,f.payload,sizeof(production.actuators));production.hasActuators=true;}
  else if(type==boat::Type::SystemHealth&&f.header.length==sizeof(production.health)){memcpy(&production.health,f.payload,sizeof(production.health));production.hasHealth=true;}
  else if(type==boat::Type::WaypointAck&&f.header.length==sizeof(production.waypointAck)){memcpy(&production.waypointAck,f.payload,sizeof(production.waypointAck));production.hasWaypointAck=true;}
  portEXIT_CRITICAL(&cacheMux);
}
void processControlByte(uint8_t value){
  ++controlRxBytes;const uint32_t encodedBytes=++controlEncodedFrameBytes;if(value==0){++controlCobsDelimiters;controlEncodedFrameBytes=0;}if(uartRxDiagMode==UartRxDiagMode::Raw)return;
  boat::Frame f{};const uint64_t decoderStartUs=nowUs();if(!controlDecoder.feed(value,f)){controlLastDecoderUs=(uint32_t)(nowUs()-decoderStartUs);return;}controlLastDecoderUs=(uint32_t)(nowUs()-decoderStartUs);
  f.uartRxUs=nowUs();lastControlUs=f.uartRxUs;++controlFrames;const bool boundaryAck=isP1CaptureAck(f);const uint32_t delta=f.header.sequence-lastControlSequence;
  if(lastControlBootId==f.header.bootId&&lastControlSequence){
    if(delta==0)++controlSequenceDuplicates;
    else if(delta>1&&delta<0x80000000UL){if(f.header.sequence<lastControlSequence)++controlSequenceWraps;controlSequenceGaps+=delta-1;recordSequenceGap(lastControlSequence,f.header.sequence,delta-1,lastControlType,f.header.type,controlLastDecoderUs,controlRxContextElapsedUs,(uint16_t)controlRxContextBuffered,f.uartRxUs);}
    else if(delta>=0x80000000UL)++controlSequenceOutOfOrder;
  }
  lastControlBootId=f.header.bootId;lastControlSequence=f.header.sequence;
  if((logging||logFinalizing)&&trialTargetActive&&!boundaryAck){if(!trialHasSequence){trialFirstSequence=f.header.sequence;trialHasSequence=true;}trialLastSequence=f.header.sequence;}
  const uint8_t previousControlType=lastControlType;lastControlType=f.header.type;if((boat::Type)f.header.type==boat::Type::P1Capture){char hex[49]{};const uint16_t n=min<uint16_t>(f.header.length,16);for(uint16_t i=0;i<n;++i)snprintf(hex+i*3,sizeof(hex)-i*3,"%02X ",f.payload[i]);Serial.printf("TYPE23_IDENTIFIED rx_us=%llu uart_sequence=%lu type=%u payload_length=%u payload_hex=%s encoded_bytes=%lu crc=ok cobs=ok length=%s previous_type=%u boundary_ack=%d\n",(unsigned long long)f.uartRxUs,(unsigned long)f.header.sequence,(unsigned)f.header.type,(unsigned)f.header.length,hex,(unsigned long)encodedBytes,expectedPayloadLength(f.header.type)==f.header.length?"ok":"mismatch",(unsigned)previousControlType,boundaryAck?1:0);}updateTypeStat(f,encodedBytes);if((boat::Type)f.header.type==boat::Type::ControlCommandAck){if(commandMutex)xSemaphoreTake(commandMutex,portMAX_DELAY);competitionCommands.handleAck(f,f.uartRxUs);if(commandMutex)xSemaphoreGive(commandMutex);}const bool bno=isBnoType(f.header.type);const uint8_t kind=bnoKindForFrame(f);
  if(bno){if(kind){++bnoValidFrames;++bnoKindFrames[kind];if(trialTargetActive&&!boundaryAck){updateCoreBnoArrival(kind,f.uartRxUs);const boat::BnoPayload* bp=reinterpret_cast<const boat::BnoPayload*>(f.payload);Serial.printf("BNO_CORE_EVENT kind=%u report_seq=%u uart_sequence=%lu sensor_raw=%llu sensor_converted=%llu xiao_rx=%llu queue_push=%llu core_rx=%llu\n",(unsigned)kind,(unsigned)bp->sequence,(unsigned long)f.header.sequence,(unsigned long long)bp->sensorUs,(unsigned long long)extendBnoTimestamp(kind,bp->sensorUs),(unsigned long long)bp->callbackUs,(unsigned long long)bp->queuePushUs,(unsigned long long)f.uartRxUs);}}else ++bnoInvalidKindFrames;}else if(!strcmp(typeName(f.header.type),"UNKNOWN"))++unknownTypeFrames;
  if(boundaryAck)handleP1CaptureAck(f);
  if(uartRxDiagMode==UartRxDiagMode::DecodeCount)return;
  cacheFrame(f);
  if((boat::Type)f.header.type==boat::Type::TimeSyncReply&&f.header.length==sizeof(boat::TimeSyncReplyPayload)){boat::TimeSyncReplyPayload r{};memcpy(&r,f.payload,sizeof(r));const uint64_t t4=nowUs();++timeSyncDiag.replies;if(timeSyncDiag.pending&&r.sequence==timeSyncDiag.pendingSequence)timeSyncDiag.pending=false;else ++timeSyncDiag.unexpectedReplies;boat::TimeSyncEstimatePayload e{};e.sequence=r.sequence;e.offsetUs=(int64_t)(((int64_t)r.t2Us-(int64_t)r.t1Us+(int64_t)r.t3Us-(int64_t)t4)/2);e.rttUs=(uint32_t)max<int64_t>(0,((int64_t)t4-(int64_t)r.t1Us)-((int64_t)r.t3Us-(int64_t)r.t2Us));e.uncertaintyUs=e.rttUs/2;e.updatedUs=t4;emitLocal(boat::Type::TimeSyncEstimate,&e,sizeof(e));}
  if(!bno||(uartRxDiagMode==UartRxDiagMode::Dispatch&&bnoLogEnqueue))enqueue(f);
}
void controlRxTask(void*){static uint8_t chunk[kControlRxChunkBytes];for(;;){++controlServiceCalls;const uint64_t startedUs=nowUs();const int availableAtStart=controlUart.available();if(availableAtStart>static_cast<int>(controlRxBufferMax))controlRxBufferMax=static_cast<uint32_t>(availableAtStart);if(availableAtStart>=16384)++controlRxBufferFullObservations;size_t n=0;const uint64_t framesBefore=controlFrames;controlRxContextElapsedUs=0;controlRxContextBuffered=(uint32_t)max(0,availableAtStart);if(availableAtStart>0){const size_t want=min<size_t>(static_cast<size_t>(availableAtStart),kControlRxChunkBytes);++controlReadCalls;n=controlUart.read(chunk,want);if(n>controlReadBytesMax)controlReadBytesMax=static_cast<uint32_t>(n);if(availableAtStart>static_cast<int>(kControlRxChunkBytes)){++controlRxBudgetHits;++controlRxByteBudgetHits;}for(size_t i=0;i<n;++i){controlRxContextElapsedUs=(uint32_t)(nowUs()-startedUs);controlRxContextBuffered=(uint32_t)max(0,controlUart.available());processControlByte(chunk[i]);}}else{++controlReadCalls;++controlZeroReadCalls;}controlServiceBytesTotal+=n;const uint64_t framesThis=controlFrames-framesBefore;if(n>controlServiceBytesMax)controlServiceBytesMax=static_cast<uint32_t>(n);if(framesThis>controlServiceFramesMax)controlServiceFramesMax=static_cast<uint32_t>(framesThis);controlServiceFramesTotal+=framesThis;const uint32_t elapsedUs=(uint32_t)(nowUs()-startedUs);if(elapsedUs>controlRxMaxServiceUs)controlRxMaxServiceUs=elapsedUs;if(elapsedUs>controlRxTaskMaxUs)controlRxTaskMaxUs=elapsedUs;if(elapsedUs>controlRxTaskMaxContinuousUs)controlRxTaskMaxContinuousUs=elapsedUs;const int buffered=controlUart.available();if(buffered>static_cast<int>(controlRxBufferMax))controlRxBufferMax=static_cast<uint32_t>(buffered);if(buffered>=16384)++controlRxBufferFullObservations;if(controlRxTaskHandle){const uint32_t hwm=(uint32_t)uxTaskGetStackHighWaterMark(controlRxTaskHandle)*sizeof(StackType_t);if(hwm<controlRxTaskStackHwmMin)controlRxTaskStackHwmMin=hwm;}crcErrors=controlDecoder.crcErrors;cobsErrors=controlDecoder.cobsErrors;lengthErrors=controlDecoder.lengthErrors;vTaskDelay(pdMS_TO_TICKS(1));}}void serviceTx(){uint32_t now=millis();if(now-lastNavMs>=kGnssNavIntervalMs){lastNavMs=now;auto n=makeNav();if(sendControl(boat::Type::GnssNavV2,&n,sizeof(n))){emitLocal(boat::Type::GnssNavV2,&n,sizeof(n));++navTx;pendingNewFix=false;}}if(now-lastHeartbeatMs>=kHeartbeatIntervalMs){lastHeartbeatMs=now;boat::HeartbeatPayload h{now,controlSeq,0,1,0};sendControl(boat::Type::Heartbeat,&h,sizeof(h));}if(timeSyncDiag.pending&&nowUs()-timeSyncDiag.pendingT1Us>2000000ULL){++timeSyncDiag.timeouts;timeSyncDiag.pending=false;}if(now-lastTimeSyncMs>=kTimeSyncIntervalMs){lastTimeSyncMs=now;boat::TimeSyncRequestPayload q{++timeSyncSeq,nowUs()};if(sendControl(boat::Type::TimeSyncRequest,&q,sizeof(q))){++timeSyncDiag.requests;timeSyncDiag.pending=true;timeSyncDiag.pendingSequence=q.sequence;timeSyncDiag.pendingT1Us=q.t1Us;}}}
bool queueCompetitionHeading(float target,uint32_t& requestId,uint32_t& sequence){requestId=nextCommandRequestId();sequence=nextCommandSequence();if(commandMutex)xSemaphoreTake(commandMutex,portMAX_DELAY);const bool ok=competitionCommands.queueHeading(target,requestId,sequence,++controlSeq,nowUs(),bootId);if(commandMutex)xSemaphoreGive(commandMutex);return ok;}
